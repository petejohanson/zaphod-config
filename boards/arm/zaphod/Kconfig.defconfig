## boards/arm/zaphod/Kconfig.defconfig
```kconfig
# Copyright (c) 2020 Pete Johanson
# SPDX-License-Identifier: MIT

if BOARD_ZAPHOD

config BOARD
	default "zaphod"

config ZMK_KEYBOARD_NAME
	default "Zaphod"

if USB

config USB_NRFX
	default y

config USB_DEVICE_STACK
	default y

endif # USB

config ZMK_DISPLAY
	select LVGL_USE_CONT
	select LVGL_FONT_MONTSERRAT_26

choice ZMK_DISPLAY_STATUS_SCREEN
	default ZMK_DISPLAY_STATUS_SCREEN_CUSTOM

endchoice

if ZMK_DISPLAY

choice LVGL_THEME_DEFAULT_FONT_NORMAL
    default LVGL_THEME_DEFAULT_FONT_NORMAL_MONTSERRAT_26

endchoice

choice LVGL_THEME_DEFAULT_FONT_SMALL
    default LVGL_THEME_DEFAULT_FONT_SMALL_MONTSERRAT_26

endchoice


config LVGL_HOR_RES_MAX
	default 144

config LVGL_VER_RES_MAX
	default 168

config SPI
	default y

config LS0XX
	default y

config LVGL_BITS_PER_PIXEL
	default 1

choice LVGL_COLOR_DEPTH
	default LVGL_COLOR_DEPTH_1

endchoice

config LVGL_DPI
	default 30

config LVGL_VDB_SIZE
	default 16

endif # ZMK_DISPLAY

config BT_CTLR
	default BT

config ZMK_BLE
	default y

config ZMK_USB
	default y

config ZMK_BATTERY_VOLTAGE_DIVIDER
	default y

endif # BOARD_ZAPHOD
```

## boards/shields/zaphod_lite/Kconfig.defconfig
```kconfig
# Copyright (c) 2020 The ZMK Contributors
# SPDX-License-Identifier: MIT

if SHIELD_ZAPHOD_LITE

config ZMK_KEYBOARD_NAME
    default "Zaphod Lite"

config SPI
	default y

config ZMK_DISPLAY
	select LV_USE_CONT
	select LV_FONT_MONTSERRAT_26

if ZMK_DISPLAY

config SYSTEM_WORKQUEUE_STACK_SIZE
    default 2048

config LV_Z_MEM_POOL_SIZE
     default 4096

choice LV_FONT_DEFAULT
    default LV_FONT_DEFAULT_MONTSERRAT_26

endchoice

choice ZMK_LV_FONT_DEFAULT_SMALL
    default ZMK_LV_FONT_DEFAULT_SMALL_MONTSERRAT_26

endchoice

config LS0XX
	default y

config LV_Z_BITS_PER_PIXEL
	default 1

choice LV_COLOR_DEPTH
	default LV_COLOR_DEPTH_1

endchoice

config LV_DPI_DEF
	default 30

config LV_Z_VDB_SIZE
	default 16

endif # ZMK_DISPLAY

endif # SHIELD_ZAPHOD_LITE
```

## boards/shields/zaphod_lite/Kconfig.shield
```kconfig
# Copyright (c) 2021 The ZMK Contributors
# SPDX-License-Identifier: MIT

config SHIELD_ZAPHOD_LITE
   def_bool $(shields_list_contains,zaphod_lite)
```

## west.yml
```yaml
manifest:
  remotes:
    - name: zmkfirmware
      url-base: https://github.com/zmkfirmware
    - name: petejohanson
      url-base: https://github.com/petejohanson
  projects:
    - name: zmk
      remote: petejohanson
      revision: boards/seeeduino-xiao-ble-add-settings-storage
      import: app/west.yml
  self:
    path: config
```
